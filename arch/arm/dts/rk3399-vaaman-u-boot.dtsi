// SPDX-License-Identifier: GPL-2.0+
/*
 * Copyright (c) 2023 Utsav Balar <utsavbalar1231@gmail.com>
 */

#include "rk3399-u-boot.dtsi"
#include "rk3399-sdram-lpddr4-100.dtsi"

/ {
	chosen {
		u-boot,spl-boot-order = "same-as-spl", &sdmmc, &sdhci;
	};
};
